#include "nrf.h"
#include "nrf_gpio.h"
#include "oled.h"
#include "nrf_delay.h"

/***************************16*16?????????:??棗???棗????*********/

unsigned char  F16x16[] = 	  	 
{  	  
0x40,0x40,0x80,0xF0,0x80,0x40,0x40,0x00,0x02,0x02,0x01,0x0F,0x01,0x02,0x02,0x00,/*"*",0*/
0x40,0x40,0x80,0xF0,0x80,0x40,0x40,0x00,0x02,0x02,0x01,0x0F,0x01,0x02,0x02,0x00,/*"*",1*/
0x40,0x40,0x80,0xF0,0x80,0x40,0x40,0x00,0x02,0x02,0x01,0x0F,0x01,0x02,0x02,0x00,/*"*",0*/
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0x00,0x00,0xFF,0x00,0x3F,0x10,0x10,0x10,0x9F,0x40,0x37,0x08,0x36,0x41,0x80,0x00,/*"?",7*/
};

unsigned char  BMP[] = 	  	 
{ 
0x00,0x00,0x00,0x00,0x00,0x00,0x00,0x00,0x00,0x00,0x00,0x00,0x00,0x00,0x00,0x00,
0x00,0x00,0x00,0x00,0x00,0x00,0x00,0x00,0x40,0xC0,0xC0,0xC0,0x80,0x80,0x00,0x00,
0x00,0x80,0x80,0xC0,0xC0,0xE0,0xE0,0xE0,0xE0,0xE0,0xE0,0x60,0x20,0x30,0x30,0x30,
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0x00,0x00,0x00,0x00,0x00,0x00,0x00,0x00,0x00,0x00,0x00,0x00,0x00,0x00,0x00,0x00,/*"C:\Users\salers\Desktop\0000.bmp",0*/
};

/************************************6*8???************************************/
const unsigned char  F6x8[][6] =		
{
0x00, 0x00, 0x00, 0x00, 0x00, 0x00,// sp
0x00, 0x00, 0x00, 0x2f, 0x00, 0x00,// !
0x00, 0x00, 0x07, 0x00, 0x07, 0x00,// "
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0x14, 0x14, 0x14, 0x14, 0x14, 0x14,// horiz lines
};

/****************************************8*16???************************************/
const unsigned char  F8X16[]=	  
{
  0x00,0x00,0x00,0x00,0x00,0x00,0x00,0x00,0x00,0x00,0x00,0x00,0x00,0x00,0x00,0x00,// 0
  0x00,0x00,0x00,0xF8,0x00,0x00,0x00,0x00,0x00,0x00,0x00,0x33,0x30,0x00,0x00,0x00,//! 1
  0x00,0x10,0x0C,0x06,0x10,0x0C,0x06,0x00,0x00,0x00,0x00,0x00,0x00,0x00,0x00,0x00,//" 2
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  0x00,0x06,0x01,0x01,0x02,0x02,0x04,0x04,0x00,0x00,0x00,0x00,0x00,0x00,0x00,0x00,//~ 94
};




/*********************LCD 延时1ms************************************/
void LCD_DLY_ms(unsigned int ms)
{   

nrf_delay_ms(ms);	
//unsigned int a;
//while(ms)
//{
//a=450;
//while(a--);
//ms--;
//}
//return;
}
/*********************LCD写数据************************************/ 
void LCD_WrDat(unsigned char dat)	 
{
unsigned char i;
nrf_gpio_pin_set(LCD_DC);
//LCD_DC=1;  
for(i=0;i<8;i++) //发送一个八位数据 
{
if((dat << i) & 0x80)
{nrf_gpio_pin_set(LCD_SDA);}
//{LCD_SDA  = 1;}
else
//  LCD_SDA  = 0;
nrf_gpio_pin_clear(LCD_SDA);
nrf_gpio_pin_clear(LCD_SCL);
nrf_gpio_pin_set(LCD_SCL);
//LCD_SCL = 0;
//LCD_SCL = 1;
}
}
/*********************LCD写命令************************************/										
void LCD_WrCmd(unsigned char cmd)
{
unsigned char i;
nrf_gpio_pin_clear(LCD_DC);
//LCD_DC=0;
for(i=0;i<8;i++) //发送一个八位数据 
{
if((cmd << i) & 0x80)
//{LCD_SDA  = 1;}
{nrf_gpio_pin_set(LCD_SDA);}
else 
//	LCD_SDA  = 0;
nrf_gpio_pin_clear(LCD_SDA);
nrf_gpio_pin_clear(LCD_SCL);
nrf_gpio_pin_set(LCD_SCL);
//LCD_SCL = 0;
//LCD_SCL = 1;
}
}
/*********************LCD 设置坐标************************************/
void LCD_Set_Pos(unsigned char x, unsigned char y) 
{ 
LCD_WrCmd(0xb0+y);
LCD_WrCmd(((x&0xf0)>>4)|0x10);
LCD_WrCmd((x&0x0f)|0x01); 
} 
/*********************LCD全屏************************************/
void LCD_Fill(unsigned char bmp_dat) 
{
unsigned char y,x;
for(y=0;y<8;y++)
{
LCD_WrCmd(0xb0+y);
LCD_WrCmd(0x01);
LCD_WrCmd(0x10);
for(x=0;x<X_WIDTH;x++)
LCD_WrDat(bmp_dat);
}
}
/*********************LCD复位************************************/
void LCD_CLS(void)
{
unsigned char y,x;	
for(y=0;y<8;y++)
{
LCD_WrCmd(0xb0+y);
LCD_WrCmd(0x01);
LCD_WrCmd(0x10); 
for(x=0;x<X_WIDTH;x++)
LCD_WrDat(0);
}
}
/*********************LCD初始化************************************/
void LCD_Init(void)     
{  
nrf_gpio_pin_set(LCD_SCL);
//LCD_SCL=1;
nrf_gpio_pin_clear(LCD_RST);
//LCD_RST=0;
LCD_DLY_ms(50);
nrf_gpio_pin_set(LCD_RST);
//LCD_RST=1;       //从上电到下面开始初始化要有足够的时间，即等待RC复位完毕   
LCD_WrCmd(0xae);//--turn off oled panel
LCD_WrCmd(0x00);//---set low column address
LCD_WrCmd(0x10);//---set high column address
LCD_WrCmd(0x40);//--set start line address  Set Mapping RAM Display Start Line (0x00~0x3F)
LCD_WrCmd(0x81);//--set contrast control register
LCD_WrCmd(0xcf); // Set SEG Output Current Brightness
	//LCD_WrCmd(0xcf); // Set SEG Output Current Brightness
LCD_WrCmd(0xa1);//--Set SEG/Column Mapping     0xa0左右反置 0xa1正常
LCD_WrCmd(0xc8);//Set COM/Row Scan Direction   0xc0上下反置 0xc8正常
LCD_WrCmd(0xa6);//--set normal display
LCD_WrCmd(0xa8);//--set multiplex ratio(1 to 64)
LCD_WrCmd(0x3f);//--1/64 duty
LCD_WrCmd(0xd3);//-set display offset	Shift Mapping RAM Counter (0x00~0x3F)
LCD_WrCmd(0x00);//-not offset
LCD_WrCmd(0xd5);//--set display clock divide ratio/oscillator frequency
LCD_WrCmd(0x80);//--set divide ratio, Set Clock as 100 Frames/Sec
LCD_WrCmd(0xd9);//--set pre-charge period
LCD_WrCmd(0xf1);//Set Pre-Charge as 15 Clocks & Discharge as 1 Clock
LCD_WrCmd(0xda);//--set com pins hardware configuration
LCD_WrCmd(0x12);
LCD_WrCmd(0xdb);//--set vcomh
LCD_WrCmd(0x40);//Set VCOM Deselect Level
LCD_WrCmd(0x20);//-Set Page Addressing Mode (0x00/0x01/0x02)
LCD_WrCmd(0x02);//
LCD_WrCmd(0x8d);//--set Charge Pump enable/disable
LCD_WrCmd(0x14);//--set(0x10) disable
LCD_WrCmd(0xa4);// Disable Entire Display On (0xa4/0xa5)
LCD_WrCmd(0xa6);// Disable Inverse Display On (0xa6/a7) 
LCD_WrCmd(0xaf);//--turn on oled panel
LCD_Fill(0x00);  //初始清屏
LCD_Set_Pos(0,0); 	
} 
/***************功能描述：显示6*8一组标准ASCII字符串	显示的坐标（x,y），y为页范围0～7****************/
void LCD_P6x8Str(unsigned char x, unsigned char y,unsigned char ch[])
{
unsigned char c=0,i=0,j=0;      
while (ch[j]!='\0')
{    
c =ch[j]-32;
if(x>126){x=0;y++;}
LCD_Set_Pos(x,y);    
for(i=0;i<6;i++)     
LCD_WrDat(F6x8[c][i]);  
x+=6;
j++;
}
}
/*******************功能描述：显示8*16一组标准ASCII字符串	 显示的坐标（x,y），y为页范围0～7****************/
void LCD_P8x16Str(unsigned char x, unsigned y,unsigned char ch[])
{
unsigned char c=0,i=0,j=0;
while (ch[j]!='\0')
{    
c =ch[j]-32;
if(x>120){x=0;y++;}
LCD_Set_Pos(x,y);    
for(i=0;i<8;i++)     
LCD_WrDat(F8X16[c*16+i]);
LCD_Set_Pos(x,y+1);    
for(i=0;i<8;i++)     
LCD_WrDat(F8X16[c*16+i+8]);  
x+=8;
j++;
}
}
/*****************功能描述：显示16*16点阵  显示的坐标（x,y），y为页范围0～7****************************/
void LCD_P16x16Ch(unsigned char x, unsigned char y,unsigned char  N)
{
unsigned char wm=0;
unsigned int adder=32*N;  //  	
LCD_Set_Pos(x , y);
for(wm = 0;wm < 16;wm++)  //             
{
LCD_WrDat(F16x16[adder]);	
adder += 1;
}      
LCD_Set_Pos(x,y + 1); 
for(wm = 0;wm < 16;wm++) //         
{
LCD_WrDat(F16x16[adder]);
adder += 1;
} 	  	
}
/***********功能描述：显示显示BMP图片128×64起始点坐标(x,y),x的范围0～127，y为页的范围0～7*****************/
void Draw_BMP(unsigned char x0, unsigned char y0,unsigned char x1, unsigned char y1,unsigned char BMP[])
{ 	
 unsigned int j=0;
 unsigned char x,y;
  
  if(y1%8==0) y=y1/8;      
  else y=y1/8+1;
	for(y=y0;y<y1;y++)
	{
		LCD_Set_Pos(x0,y);				
    for(x=x0;x<x1;x++)
	    {      
	    	LCD_WrDat(BMP[j++]);	    	
	    }
	}
} 
